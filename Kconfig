## driver/dma-library/Kconfig
```kconfig
config HN_COREDMA
    bool "core to core dma"
    default n
    depends on MBOX
    depends on MEM_ATTR
    depends on SECOND_CORE_MCUX
    help
      Enables the dma driver for core to core communication on the FRDM MCXN 947 Board
```

## dts/bindings/input/hn,coredma.yaml
```yaml
description: HN Core DMA shared-memory

compatible: "hn,coredma"

include: base.yaml

properties:  
  memory-region:
    type: phandle
    required: true
    description: Phandle to a reserved-memory node used as the shared memory region.

  chan-size:
    type: int
    required: true
    description: Bytes per channel

  chan-amt:
    type: int
    required: true
    description: Number of channels

  is-master:
    type: boolean
    description: Whether this core uses RX/TX mapping as master
```
